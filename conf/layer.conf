## conf/layer.conf
```bitbake
# conf and classes directory append to BBPATH
BBPATH .= ":${LAYERDIR}"

# Recipes
BBFILES += "${LAYERDIR}/recipes*/*/*.bb ${LAYERDIR}/recipes*/*/*.bbappend ${LAYERDIR}/images/*.bb"

BBFILE_COLLECTIONS += "meta-wizewater"
BBFILE_PATTERN_meta-wizewater := "^${LAYERDIR}/"
BBFILE_PRIORITY_meta-wizewater = "8"
```
